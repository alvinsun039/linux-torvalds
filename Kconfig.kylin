## Kconfig.kylin
```kconfig
# SPDX-License-Identifier: GPL-2.0
#
# KYLIN specific options
#

menu "KYLINOS options"

config KYLIN_KERNEL
	def_bool y

config KY_KABI_SIZE_ALIGN_CHECKS
	bool "Enables more stringent kabi checks in the macros"
	help
	  This option enables more stringent kabi checks. Those must be disable
	  in case of a debug-build because they allow to change struct sizes.

config KYLIN_DIFFERENCES
	bool "Remove support for deprecated features"
	help
	  KYLINOS may choose to deprecate certain features in its kernels.
	  Enable this option to remove support for hardware that is no
	  longer supported.

	  Unless you want a restricted kernel, say N here.

endmenu
```

## drivers/clk/cix/Kconfig
```kconfig
# SPDX-License-Identifier: GPL-2.0
# Common clock support for Cixtech SoC family
menu "Clock support for Cixtech"

comment "Clock options for Cixtech CPUs:"

config COMMON_CLK_CIX
	bool "Support for Cix's clock controllers"
	select REGMAP_MMIO
	select RESET_CONTROLLER
	depends on ARM64
	help
	  Say y here to enable common clock controller for Cix platforms.

endmenu
```

## drivers/gpu/drm/arise/Kconfig
```kconfig
config DRM_ARISE
	tristate "Arise DRM"
	default m
	depends on DRM && !RISCV && !SW64
	select DRM_KMS_HELPER
	help
	  Choose this option if you have an Glenfly Arise GPU. If M is selected
	  the module will be called arise.
```

## drivers/gpu/drm/gb02/Kconfig
```kconfig
config DRM_GB02
	tristate "GB02 chip"
	depends on DRM && SND_PCM
	select DRM_KMS_HELPER
	select DRM_VRAM_HELPER
	select DRM_TTM
	select DRM_SCHED
	select FB_IOMEM_HELPERS if DRM_FBDEV_EMULATION
	select DRM_GEM_SHMEM_HELPER
	select DRM_DEVFREQ
	select DRM_TTM_HELPER
	help
	  Choose this option if you have a sietium graphics card. 
          If M is selected, the module will be called gb02 (C21).
          
if DRM_GB02
config MCU_PERI
    bool "Enable MCU Peripheral Control"
    default y

config MCU_I2C
    bool "MCU I2C Interface"
    default n
    depends on MCU_PERI

config MCU_UART
    bool "MCU UART Interface"
    default n
    depends on MCU_PERI

config MCU_GPIO
    bool "MCU GPIO Control"
    default y
    depends on MCU_PERI

config MCU_PWM
    bool "MCU PWM Output"
    default n
    depends on MCU_PERI
    
config MCU_SPI
    bool "MCU SPI Output"
    default n
    depends on MCU_PERI    

config GPIO_PWM
    bool "GPIO-based PWM"
    default n
    depends on MCU_PERI

config MCU_PVT
    bool "MCU PVT Sensor"
    default y
    depends on MCU_PERI
    
config MCU_FREQ
    bool "MCU FREQ Sensor"
    default y
    depends on MCU_PERI
    
config MCU_FAN
    bool "MCU FAN Sensor"
    default y
    depends on MCU_PERI

config SN_INFO
    bool
    default y if DRM_GB02

config PCIE_MSG
    bool
    default y if DRM_GB02

config GB_BACKLIGHT
    bool "GB02 Backlight Control"
    default y
    depends on DRM_GB02

endif  # DRM_GB02
```

## drivers/gpu/drm/mwv207d/Kconfig
```kconfig
config DRM_MWV207D
	tristate "MWV207D chip"
	depends on DRM && SND_PCM
	select DRM_KMS_HELPER
	select DRM_VRAM_HELPER
	select DRM_TTM
	select DRM_TTM_HELPER
	help
	  Choose this option if you have a Jingjia graphics card. 
          If M is selected, the module will be called mwv207d (JH960、JM1100).
```

## drivers/net/ethernet/grtnic_xgb/Kconfig
```kconfig
config NET_VENDOR_GRTNIC_XGB
	tristate "Grtnic PCI-Express Gigabit Ethernet support"
	depends on PCI && m && NET
	default m
	help
	  This driver supports grtnic gigabit ethernet family of adapters.
```

## drivers/net/ethernet/huawei/bma/Kconfig
```kconfig
#
# Huawei BMA software driver configuration
#

config BMA
	tristate "Huawei BMA Driver"
	depends on 64BIT
	depends on m
	help
	  This driver supports Huawei BMA Software. It is used
	  to communication between Huawei BMA and BMC software.
```

## drivers/net/wireless/realtek/rtl8188FU/Kconfig
```kconfig
config RTL8188FU
	tristate "Realtek 8188F USB WiFi"
	depends on USB
	depends on m
	depends on RTL8XXXU = n
	help
	  Help message of RTL8818FU
```

## drivers/net/wireless/realtek/rtl8192FU/Kconfig
```kconfig
config RTL8192FU
	tristate "Realtek 8192F USB WiFi"
	depends on USB
	depends on RTL8XXXU = n
	help
	  Help message of RTL8192FU
```

## drivers/net/wireless/realtek/rtl8723DU/Kconfig
```kconfig
config RTL8723DU
	tristate "Realtek 8723D USB WiFi"
	depends on m
	help
	  Help message of RTL8723DU
```

## drivers/net/wireless/realtek/rtl8821CU/Kconfig
```kconfig
config RTL8821CU
	tristate "Realtek 8821C USB WiFi"
	depends on USB
	depends on RTW88_8821CU = n
	help
	  Help message of RTL8821CU
```

## drivers/net/wireless/realtek/rtl8851BU/Kconfig
```kconfig
config RTL8851BU
	tristate "Realtek 8851B USB WiFi"
	depends on USB
	depends on m
	help
	  Help message of RTL8851BU
```

## drivers/net/wireless/realtek/rtl8852BU/Kconfig
```kconfig
config RTL8852BU
	tristate "Realtek 8852B USB WiFi"
	depends on USB
	depends on m
	help
	  Help message of RTL8852BU
```

## drivers/net/wireless/realtek/rtl8852CU/Kconfig
```kconfig
config RTL8852CU
	tristate "Realtek 8852C USB WiFi"
	depends on USB
	depends on m
	help
	  Help message of RTL8852CU
```

## drivers/net/wireless/realtek/rtl88x2CU/Kconfig
```kconfig
config RTL8822CU
	tristate "Realtek 8822C USB WiFi"
	depends on USB
	depends on RTW88_8822CU = n
	help
	  Help message of RTL8822CU
```

## drivers/phy/cix/Kconfig
```kconfig
# SPDX-License-Identifier: GPL-2.0-only
#
# Phy drivers for Cix PHYs
#

config PHY_CIX_USBDP
	bool "Cix USBDP PHY Driver"
	depends on ARM64 && OF && HAS_IOMEM
	select GENERIC_PHY
	help
	  Enable this to support the CIX USBDP PHY for TYPEC Connection

config PHY_CIX_USB2
	bool "Cix USB2 PHY Driver"
	depends on ARM64 && OF
	select GENERIC_PHY
	help
	  Enable this to support the CIX USB2 PHY

config PHY_CIX_USB3
	bool "Cix USB3 PHY Driver"
	depends on ARM64 && OF && HAS_IOMEM
	select GENERIC_PHY
	help
	  Enable this to support the CIX USB3 PHY for TYPEA Connection
```

## drivers/scsi/ccusr/Kconfig
```kconfig
#
# Kernel configuration file for the CCUSR
#

config CCUSR_RAID
	tristate "CCUSR HW-RAID Adapter"
	depends on PCI && SCSI
	default m
	help
	  This driver supports C*Core CCUSR series of RAID controllers.
	  To compile this driver as a module, choose M here: the module will
	  be called ccusr.
```

## drivers/scsi/cetc52raid/Kconfig
```kconfig
#
# Kernel configuration file for the CETC52RAID
#

config SCSI_CETC52RAID
	tristate "Cetc52 RAID Adapter"
	depends on PCI && SCSI
	select SCSI_SAS_ATTRS
	select RAID_ATTRS
	select IRQ_POLL
	help
	This driver supports CETC52 RAID controller, which supports PCI Express Gen4 interface
	and supports SAS/SATA HDD/SSD.
	To compile this driver as a module, choose M here.
```

## drivers/soc/cix/Kconfig
```kconfig
# SPDX-License-Identifier: GPL-2.0-only
menu "Cix Dst drivers"

config SOC_CIX
	bool "Cix Sky SoC family support"
	default n
	depends on ARM64
	help
	  If you say yes here you get support for the Cix sky family
	  support, it will provide the SoC info like SoC family,
	  ID and revision etc.

config CIX_SKY1_SOCINFO
	bool "Cix Sky1 SoC Information driver"
	select SOC_BUS
	depends on ARM64
	help
	  Say yes to support decoding of CIX Sky1 SoC family information
	  about the type and version.

config CIX_SOC_ACPI
	bool "Cix SoC ACPI drivers"
	depends on ACPI && ARM64
	select SOC_BUS
	help
	  Say yes to support CIX SoC ACPI drivers.

endmenu
```
